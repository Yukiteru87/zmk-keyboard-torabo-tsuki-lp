#include "torabo_tsuki_lp.dtsi"
#include <input/processors.dtsi>
#include <dt-bindings/zmk/input_transform.h>
#include <input/processors/runtime-input-processor.dtsi>

// mouse: ポインタ速度・オートマウスレイヤー / scroll: スクロールレイヤー中だけXY→スクロール変換
// 数値の初期値は config/keymap.keymap 側で設定(DYA Studioから実行時に変更可)
&pointing_listener {
    input-processors = <&zip_xy_transform (INPUT_TRANSFORM_X_INVERT | INPUT_TRANSFORM_Y_INVERT) &mouse_runtime_input_processor &scroll_runtime_input_processor>;
};

&scroll_runtime_input_processor {
    x-codes = <INPUT_REL_X>;
    y-codes = <INPUT_REL_Y>;
    xy-to-scroll-enabled;
};
