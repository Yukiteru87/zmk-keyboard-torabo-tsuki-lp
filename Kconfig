## config/west.yml
```yaml
manifest:
  remotes:
    - name: sekigon-gonnoc
      url-base: https://github.com/sekigon-gonnoc
    - name: cormoran
      url-base: https://github.com/cormoran
  projects:
    # ZMK v0.4 (Zephyr 4.1) 系の DYA Studio 対応 fork。動作確認した時点(2026-10-30)のコミットに固定
    - name: zmk
      remote: cormoran
      revision: e5c9b6915b56801193e359dd9bad4a167ce0d1b8 # main+dya
      import: app/west.yml
    - name: zmk-component-bmp-boost
      remote: sekigon-gonnoc
      revision: 2f5567523b6f0bc39575d48ed746ed9d635edf8b # master (v0.4 対応)
      import: west.yml
    - name: zmk-feature-status-led
      remote: sekigon-gonnoc
      revision: 1f827a452013199e42544d47fdf27e5ebd2d7b4b # main
    - name: zmk-driver-paw3222
      remote: sekigon-gonnoc
      revision: 0e1835c57f88d215ce401b6d0901f361629621fc # torabo-tsuki
    - name: zmk-driver-iqs7211e
      remote: sekigon-gonnoc
      revision: 436d3c42172abf812ec104521f29384fc02fc50e # master
    - name: zmk-feature-cdc-acm-bootloader-trigger
      remote: sekigon-gonnoc
      revision: 37ca1ef9e42d62040387590542585da033d12571 # main (v0.4 対応)
    - name: zmk-feature-non-lipo-battery-management
      remote: sekigon-gonnoc
      revision: 43fa56fb7d1e065393e926b6caa0ea02cb86eca7 # main
    # DYA Studio 用モジュール
    - name: zmk-module-ble-management
      remote: cormoran
      revision: 57738cc4fc6ba80e82a7ac57741a0339cb186cd4 # main
    - name: zmk-module-settings-rpc
      remote: cormoran
      revision: 78f86df9e6c5edaf57bef3ccbd7f360cfdf49291 # main
    - name: zmk-module-runtime-input-processor
      remote: cormoran
      revision: decf628d7ce5ed95b520c650824c28ea9de649c1 # main
    - name: zmk-feature-custom-settings
      remote: cormoran
      revision: c6a7fef3a3be3d3ace5de9a4b0628c6418cd1f3f # main
    # フリーズ・クラッシュの検出と記録 (記録して自動再起動。DYA Studio の「安定性」タブで確認)
    - name: zmk-feature-watchdog
      remote: cormoran
      revision: 84ad14c6c3645dc40b23f45d08ab45418655f912 # main
    # DYA Studio の診断タブ用
    - name: zmk-feature-device-info
      remote: cormoran
      revision: 8cedd2dd9f04e19ea5a17b94914dd47a09d8db11 # main
    - name: zmk-feature-kscan-diagnostics
      remote: cormoran
      revision: 1432f7fe0cfe903cd7d3c9931ae6bd6f2e1f328e # main
    - name: zmk-feature-input-stream
      remote: cormoran
      revision: aeb015908a42a7615ccdccc7feb3a10d23132a71 # main
    - name: zmk-module-devtool
      remote: cormoran
      revision: 9938a2c73c06d6e65ba2c0b68c9aa044a467eafc # main
  self:
    path: config
```
